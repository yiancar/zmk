## app/dts/bindings/behaviors/zmk,behavior-rgb-underglow-test.yaml
```yaml
description: Test-only RGB underglow transaction action

compatible: "zmk,behavior-rgb-underglow-test"

include: one_param.yaml
```

## app/dts/bindings/behaviors/zmk,behavior-studio-rpc-tx-test.yaml
```yaml
description: Test-only Studio RPC TX streaming action

compatible: "zmk,behavior-studio-rpc-tx-test"

include: zero_param.yaml
```

## app/dts/bindings/zmk,led-strip-mock.yaml
```yaml
description: Mock LED strip used by native ZMK tests

compatible: "zmk,led-strip-mock"

include: base.yaml

properties:
  chain-length:
    type: int
    required: true
    description: Number of RGB pixels exposed by the mock strip
```

## app/module/drivers/led_strip/Kconfig
```kconfig
# Copyright (c) 2026 The ZMK Contributors
# SPDX-License-Identifier: MIT

if LED_STRIP

config ZMK_LED_STRIP_MOCK
    bool "Mock LED strip"
    default y
    depends on DT_HAS_ZMK_LED_STRIP_MOCK_ENABLED
    help
      Enable the LED strip mock used by native ZMK tests.

endif
```
